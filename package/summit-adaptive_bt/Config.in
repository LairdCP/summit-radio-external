## package/summit-adaptive_bt/Config.in
```kconfig
config BR2_PACKAGE_SUMMIT_ADAPTIVE_BT
	bool "Adaptive Bluetooth Power Service"
	select BR2_PACKAGE_BLUEZ5_UTILS_HEADERS
	select BR2_PACKAGE_LIBNL
	help
		60 Series Radio's Adaptive Bluetooth Power Control
```

## package/summit-brcm-patchram-plus/Config.in
```kconfig
config BR2_PACKAGE_SUMMIT_BRCM_PATCHRAM_PLUS
	bool "Summit brcm-patchram-plus"
	depends on BR2_PACKAGE_BLUEZ5_UTILS || BR2_PACKAGE_BLUEZ4_UTILS
	help
	  Broadcom utility to flash Bluetooth firmwares, extended with
	  per-device Low Power Mode configuration.
```

## package/summit-firmware-60/Config.in
```kconfig
config BR2_PACKAGE_SUMMIT_FIRMWARE_60
	bool "60 Series Radio Firmware"

if BR2_PACKAGE_SUMMIT_FIRMWARE_60

config BR2_PACKAGE_SUMMIT_FIRMWARE_60_SDIO_UART
	bool "SDIO-UART"

config BR2_PACKAGE_SUMMIT_FIRMWARE_60_SDIO_SDIO
	bool "SDIO-SDIO"

config BR2_PACKAGE_SUMMIT_FIRMWARE_60_PCIE_UART
	bool "PCIE-UART"

config BR2_PACKAGE_SUMMIT_FIRMWARE_60_PCIE_USB
	bool "PCIE-USB"

config BR2_PACKAGE_SUMMIT_FIRMWARE_60_USB_USB
	bool "USB-USB"

config BR2_PACKAGE_SUMMIT_FIRMWARE_60_SOM8MP
	bool "Summit SOM8MP"

endif
```

## package/summit-firmware-lwb-if/Config.in
```kconfig
config BR2_PACKAGE_SUMMIT_FIRMWARE_LWB_IF
	bool "LWB/IF Series Radio Firmware"

if BR2_PACKAGE_SUMMIT_FIRMWARE_LWB_IF

config BR2_PACKAGE_SUMMIT_FIRMWARE_LWB_IF_LWB_FCC
	bool "LWB FCC"

config BR2_PACKAGE_SUMMIT_FIRMWARE_LWB_IF_LWB_ETSI
	bool "LWB ETSI"

config BR2_PACKAGE_SUMMIT_FIRMWARE_LWB_IF_LWB_JP
	bool "LWB JP"

config BR2_PACKAGE_SUMMIT_FIRMWARE_LWB_IF_LWB5_FCC
	bool "LWB5 FCC"

config BR2_PACKAGE_SUMMIT_FIRMWARE_LWB_IF_LWB5_IC
	bool "LWB5 IC"

config BR2_PACKAGE_SUMMIT_FIRMWARE_LWB_IF_LWB5_ETSI
	bool "LWB5 ETSI"

config BR2_PACKAGE_SUMMIT_FIRMWARE_LWB_IF_LWB5_JP
	bool "LWB5 JP"

config BR2_PACKAGE_SUMMIT_FIRMWARE_LWB_IF_LWB5PLUS_SDIO_DIV
	bool "LWB5+ SDIO-DIV"

config BR2_PACKAGE_SUMMIT_FIRMWARE_LWB_IF_LWB5PLUS_SDIO_SA
	bool "LWB5+ SDIO-SA"

config BR2_PACKAGE_SUMMIT_FIRMWARE_LWB_IF_LWB5PLUS_SDIO_SA_M2
	bool "LWB5+ SDIO-SA-M2"

config BR2_PACKAGE_SUMMIT_FIRMWARE_LWB_IF_LWB5PLUS_USB_DIV
	bool "LWB5+ USB-DIV"

config BR2_PACKAGE_SUMMIT_FIRMWARE_LWB_IF_LWB5PLUS_USB_SA
	bool "LWB5+ USB-SA"

config BR2_PACKAGE_SUMMIT_FIRMWARE_LWB_IF_LWB5PLUS_USB_SA_M2
	bool "LWB5+ USB-SA-M2"

config BR2_PACKAGE_SUMMIT_FIRMWARE_LWB_IF_LWBPLUS
	bool "LWB+"

config BR2_PACKAGE_SUMMIT_FIRMWARE_LWB_IF_IF573_SDIO
	bool "IF573 SDIO"

config BR2_PACKAGE_SUMMIT_FIRMWARE_LWB_IF_IF573_PCIE
	bool "IF573 PCIE"

config BR2_PACKAGE_SUMMIT_FIRMWARE_LWB_IF_IF513
	bool "IF513"

endif
```

## package/summit-firmware-msd/Config.in
```kconfig
config BR2_PACKAGE_SUMMIT_FIRMWARE_MSD
	bool "NX61X Radio Firmware"

if BR2_PACKAGE_SUMMIT_FIRMWARE_MSD

config BR2_PACKAGE_SUMMIT_FIRMWARE_MSD_45
	bool "MSD45/WB45"

config BR2_PACKAGE_SUMMIT_FIRMWARE_MSD_50
	bool "MSD50/WB50"

endif
```

## package/summit-firmware-nx/Config.in
```kconfig
config BR2_PACKAGE_SUMMIT_FIRMWARE_NX
	bool "NX Radio Firmware"

if BR2_PACKAGE_SUMMIT_FIRMWARE_NX

config BR2_PACKAGE_SUMMIT_FIRMWARE_NX61X
	bool "NX61X"

endif
```

## package/summit-firmware-ti/Config.in
```kconfig
config BR2_PACKAGE_SUMMIT_FIRMWARE_TI
	bool "TI Radio Firmware"
	select BR2_PACKAGE_SUMMIT_FIRMWARE_DEVEL if BR2_LRD_DEVEL_BUILD

if BR2_PACKAGE_SUMMIT_FIRMWARE_TI

config BR2_PACKAGE_SUMMIT_FIRMWARE_TI_351
	bool "TI351"
	select BR2_PACKAGE_SUMMIT_FIRMWARE_DEVEL_TI351 if BR2_LRD_DEVEL_BUILD

endif
```

## package/summit-hostapd/Config.in
```kconfig
config BR2_PACKAGE_SUMMIT_HOSTAPD
	bool "Summit hostapd"
	select BR2_PACKAGE_LIBNL
	select BR2_PACKAGE_OPENSSL
	help
	  Summit hostapd

if BR2_PACKAGE_SUMMIT_HOSTAPD

choice
	prompt "Package Source"
	default BR2_PACKAGE_SUMMIT_HOSTAPD_60

config BR2_PACKAGE_SUMMIT_HOSTAPD_60
	bool "Using 60 series"

config BR2_PACKAGE_SUMMIT_HOSTAPD_MSD
	bool "Using MSD series"

config BR2_PACKAGE_SUMMIT_HOSTAPD_LWB
	bool "Using LWB/IF series"

config BR2_PACKAGE_SUMMIT_HOSTAPD_NX
	bool "Using NX series"

config BR2_PACKAGE_SUMMIT_HOSTAPD_TI
	bool "Using TI series"

endchoice

config BR2_PACKAGE_SUMMIT_HOSTAPD_CLI
	bool "Install hostapd_cli binary"
	help
	  Install hostapd_cli command line utility

endif
```

## package/summit-mfg60/Config.in
```kconfig
config BR2_PACKAGE_SUMMIT_MFG60N
	bool "60 series manufacturing tools binaries"
	select BR2_PACKAGE_LIBNL
	select BR2_PACKAGE_LIBEDIT
	help
	  This package installs 60 series manufacturing tools.

if BR2_PACKAGE_SUMMIT_MFG60N
config BR2_PACKAGE_SUMMIT_MFG60N_LMU
	bool "60 series manufacturing tool (lmu)"
	default y
	help
	  This package installs 60 series lmu for use in setting the regulatory domain.

config BR2_PACKAGE_SUMMIT_MFG60N_REGULATORY
	bool "60 series regulatory tools (lru, btlru)"
	default y
	help
	  This package installs 60 series lru and btlru for use in regulatory testing.

endif
```

## package/summit-reg45n/Config.in
```kconfig
config BR2_PACKAGE_SUMMIT_REG45N
	bool "45 series regulatory tools"
	select BR2_PACKAGE_LIBEDIT
	select BR2_PACKAGE_LRU_ATH6KL if BR2_LRD_DEVEL_BUILD
	select BR2_PACKAGE_LRU_ATH6KL_WB45N_SUPPORT if BR2_LRD_DEVEL_BUILD
	select BR2_PACKAGE_SUMMIT_FIRMWARE_DEVEL if BR2_LRD_DEVEL_BUILD
	select BR2_PACKAGE_SUMMIT_FIRMWARE_DEVEL_AR6003_MFG if BR2_LRD_DEVEL_BUILD
	help
	  This package installs 45 series regulatory tools.
```

## package/summit-reg50n/Config.in
```kconfig
config BR2_PACKAGE_SUMMIT_REG50N
	bool "50 series regulatory tools"
	select BR2_PACKAGE_LIBEDIT
	select BR2_PACKAGE_LRU_ATH6KL if BR2_LRD_DEVEL_BUILD
	select BR2_PACKAGE_LRU_ATH6KL_WB50N_SUPPORT if BR2_LRD_DEVEL_BUILD
	select BR2_PACKAGE_SUMMIT_FIRMWARE_DEVEL if BR2_LRD_DEVEL_BUILD
	select BR2_PACKAGE_SUMMIT_FIRMWARE_DEVEL_AR6004_MFG if BR2_LRD_DEVEL_BUILD
	help
	  This package installs 50 series regulatory tools.
```

## package/summit-regcypress/Config.in
```kconfig
config BR2_PACKAGE_SUMMIT_REGCYPRESS
	bool "LWB & LWB5 manufacturing tools binaries"
	select BR2_PACKAGE_LIBNL
	select BR2_PACKAGE_LIBEDIT
	select BR2_PACKAGE_WL_FMAC if BR2_LRD_DEVEL_BUILD
	select BR2_PACKAGE_SUMMIT_FIRMWARE_DEVEL if BR2_LRD_DEVEL_BUILD
	select BR2_PACKAGE_SUMMIT_FIRMWARE_DEVEL_BCM4343_MFG if BR2_LRD_DEVEL_BUILD
	select BR2_PACKAGE_SUMMIT_FIRMWARE_DEVEL_BCM4339_MFG if BR2_LRD_DEVEL_BUILD
	help
	  This package installs LWB & LWB5 manufacturing tools.
```

## package/summit-regif513/Config.in
```kconfig
config BR2_PACKAGE_SUMMIT_REGIF513
	bool "IF513 manufacturing tools binaries"
	select BR2_PACKAGE_LIBNL
	select BR2_PACKAGE_LIBEDIT
	select BR2_PACKAGE_LRU_CYPRESS if BR2_LRD_DEVEL_BUILD
	select BR2_PACKAGE_SUMMIT_FIRMWARE_DEVEL if BR2_LRD_DEVEL_BUILD
	select BR2_PACKAGE_SUMMIT_FIRMWARE_DEVEL_CYW55513_MFG if BR2_LRD_DEVEL_BUILD
	help
	  This package installs IF513 series manufacturing tools.
```

## package/summit-regif573/Config.in
```kconfig
config BR2_PACKAGE_SUMMIT_REGIF573
	bool "IF573 manufacturing tools binaries"
	select BR2_PACKAGE_LIBNL
	select BR2_PACKAGE_LIBEDIT
	select BR2_PACKAGE_LRU_CYPRESS if BR2_LRD_DEVEL_BUILD
	select BR2_PACKAGE_SUMMIT_FIRMWARE_DEVEL if BR2_LRD_DEVEL_BUILD
	select BR2_PACKAGE_SUMMIT_FIRMWARE_DEVEL_CYW5557X_MFG if BR2_LRD_DEVEL_BUILD
	help
	  This package installs IF573 series manufacturing tools.
```

## package/summit-reglwb5plus/Config.in
```kconfig
config BR2_PACKAGE_SUMMIT_REGLWB5PLUS
	bool "LWB5+ manufacturing tools binaries"
	select BR2_PACKAGE_LIBNL
	select BR2_PACKAGE_LIBEDIT
	select BR2_PACKAGE_LRU_CYPRESS if BR2_LRD_DEVEL_BUILD
	select BR2_PACKAGE_SUMMIT_FIRMWARE_DEVEL if BR2_LRD_DEVEL_BUILD
	select BR2_PACKAGE_SUMMIT_FIRMWARE_DEVEL_BCM4373_MFG if BR2_LRD_DEVEL_BUILD
	help
	  This package installs LWB5+ manufacturing tools.
```

## package/summit-reglwbplus/Config.in
```kconfig
config BR2_PACKAGE_SUMMIT_REGLWBPLUS
	bool "LWB+ manufacturing tools binaries"
	select BR2_PACKAGE_LIBNL
	select BR2_PACKAGE_LIBEDIT
	select BR2_PACKAGE_LRU_CYPRESS if BR2_LRD_DEVEL_BUILD
	select BR2_PACKAGE_SUMMIT_FIRMWARE_DEVEL if BR2_LRD_DEVEL_BUILD
	select BR2_PACKAGE_SUMMIT_FIRMWARE_DEVEL_BCM43439_MFG if BR2_LRD_DEVEL_BUILD
	help
	  This package installs LWB+ series manufacturing tools.
```
